## boards/locha/turpial/Kconfig.turpial
```kconfig
# Copyright (c) 2026 Jean-Pierre De Jesus DIAZ <me@jeandudey.tech>
#
# SPDX-License-Identifier: Apache-2.0

config BOARD_TURPIAL
	select SOC_CC1312R if BOARD_TURPIAL_CC1312R
	select SOC_ESP32_WROVER_E_N4R8 if BOARD_TURPIAL_ESP32_APPCPU
	select SOC_ESP32_WROVER_E_N4R8 if BOARD_TURPIAL_ESP32_PROCPU
	select SOC_ESP32_APPCPU if BOARD_TURPIAL_ESP32_APPCPU
	select SOC_ESP32_PROCPU if BOARD_TURPIAL_ESP32_PROCPU
```

## boards/locha/turpial/board.yml
```yaml
# Copyright (c) 2026 Jean-Pierre De Jesus DIAZ <me@jeandudey.tech>
#
# SPDX-License-Identifier: Apache-2.0

board:
  name: turpial
  full_name: Turpial
  vendor: locha
  socs:
    - name: cc1312r
    - name: esp32
```

## west.yml
```yaml
# Copyright (c) 2026 Jean-Pierre De Jesus DIAZ <me@jeandudey.tech>
#
# SPDX-License-Identifier: Apache-2.0

manifest:
  remotes:
    # Switch to zephyrproject-rtos once CC1312R support is in, this should be
    # removed, ideally one should use Zephyr upstream always.
    - name: jeandudey
      url-base: https://github.com/jeandudey
    - name: zephyrproject-rtos
      url-base: https://github.com/zephyrproject-rtos

  projects:
    - name: zephyr
      remote: jeandudey
      revision: 74ff43e52042af5e3eace81d37b1b5a1be315ea1 # Branch cc1312
      import:
        name-allowlist:
          - cmsis_6
          - hal_espressif
          - hal_ti
          - mcuboot
```
