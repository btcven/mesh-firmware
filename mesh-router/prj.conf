## CMakeLists.txt
```
# Copyright (c) 2026 Jean-Pierre De Jesus DIAZ <me@jeandudey.tech>
#
# SPDX-License-Identifier: Apache-2.0

cmake_minimum_required(VERSION 3.13.1)
find_package(Zephyr REQUIRED HINTS $ENV{ZEPHYR_BASE})

project(app LANGUAGES C)

target_sources(app PRIVATE src/main.c)
target_include_directories(
  app
  PRIVATE
  ${ZEPHYR_BASE}/subsys/net/ip
)
```

## prj.conf
```kconfig
# Copyright (c) 2026 Jean-Pierre De Jesus DIAZ <me@jeandudey.tech>
#
# SPDX-License-Identifier: Apache-2.0

CONFIG_NETWORKING=y
CONFIG_NET_DRIVERS=y
CONFIG_NET_IPV4=n
CONFIG_NET_IPV6=y
CONFIG_NET_IPV6_PMTU=y
CONFIG_NET_L2_IEEE802154=y
CONFIG_NET_L2_PPP=y
CONFIG_NET_PPP=y
CONFIG_NET_SHELL=y

CONFIG_SHELL=y
CONFIG_SHELL_BACKEND_SERIAL=y
CONFIG_SHELL_MINIMAL=y
CONFIG_UART_CONSOLE=y
CONFIG_CONSOLE=y

CONFIG_LOG=y
```

## src/main.c
```c
/*
 * Copyright (c) 2026 Jean-Pierre De Jesus DIAZ <me@jeandudey.tech>
 *
 * SPDX-License-Identifier: Apache-2.0
 */

#include <zephyr/kernel.h>
#include <route.h>

int main(void)
{
	printk("Mesh router\n");

	return 0;
}
```
